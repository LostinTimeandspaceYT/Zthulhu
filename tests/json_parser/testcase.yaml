## tests/json_parser/testcase.yaml
```yaml
tests:
  zthulhu.json_parser:
    tags:
      - json
      - parser
      - zthulhu
    platform_allow:
      - native_sim
      - native_sim/native/64
    harness: ztest
```
